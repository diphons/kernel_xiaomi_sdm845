## techpack/Kconfig
```kconfig
menu "Tech packages"

source "techpack/data/Kconfig"
source "techpack/display/Kconfig"
source "techpack/wlan/Kconfig"

source "techpack/mi845/Kconfig"

endmenu
```

## techpack/xiaomi-sdm845/Kconfig
```kconfig
menu "Xiaomi platform"

config MACH_XIAOMI
	bool "Support for Xiaomi platform"
	help
	  Say Y here to enable support for Xiaomi platform.

if MACH_XIAOMI

source "techpack/xiaomi-sdm845/mach/Kconfig"
source "techpack/xiaomi-sdm845/fingerprint/Kconfig"
source "techpack/xiaomi-sdm845/gps/Kconfig"
source "techpack/xiaomi-sdm845/halls/Kconfig"
source "techpack/xiaomi-sdm845/leds/Kconfig"
source "techpack/xiaomi-sdm845/power_supply/Kconfig"
source "techpack/xiaomi-sdm845/regulator/Kconfig"
source "techpack/xiaomi-sdm845/touchscreen/Kconfig"

endif # MACH_XIAOMI

endmenu
```

## techpack/xiaomi-sdm845/fingerprint/Kconfig
```kconfig
menu "Fingerprint"

source "techpack/xiaomi-sdm845/fingerprint/goodix_ta/Kconfig"
source "techpack/xiaomi-sdm845/fingerprint/fpc_tee/Kconfig"
source "techpack/xiaomi-sdm845/fingerprint/synaptics/Kconfig"

endmenu
```

## techpack/xiaomi-sdm845/leds/Kconfig
```kconfig
menu "LED"
	depends on NEW_LEDS

config LEDS_LM3644
	tristate "LED support for LM3644 Chip"
	depends on LEDS_CLASS && I2C
	select REGMAP_I2C
	help
	  This option enables support for LEDs connected to LM3644.
	  The LM3644 is a 4MHz fixed-frequency synchronous boost
	  converter plus 1.5A constant current driver for a high-current
	  white LED.

endmenu
```

## techpack/xiaomi-sdm845/mach/Kconfig
```kconfig
menu "Machine selection"

config MACH_XIAOMI_SDM845
	bool "Support for Xiaomi sdm845 platform"
	depends on MACH_XIAOMI
	help
	  Say Y here to enable support for Xiaomi sdm845 platform.

# Machines
config MACH_XIAOMI_D5X
	bool "polaris board"
	select MACH_XIAOMI_SDM845
	help
	  Support for Xiaomi MIX 2S.

config MACH_XIAOMI_E1N
	bool "dipper board"
	select MACH_XIAOMI_SDM845
	help
	  Support for Xiaomi MI 8.

config MACH_XIAOMI_E10
	bool "beryllium board"
	select MACH_XIAOMI_SDM845
	help
	  Support for Xiaomi Poco F1.

config MACH_XIAOMI_E1S
	bool "equuleus board"
	select MACH_XIAOMI_SDM845
	help
	  Support for Xiaomi MI 8 Pro.

config MACH_XIAOMI_E5
	bool "perseus board"
	select MACH_XIAOMI_SDM845
	help
	  Support for Xiaomi MIX 3.

config MACH_XIAOMI_E8
	bool "ursa board"
	select MACH_XIAOMI_SDM845
	help
	  Support for Xiaomi MI 8 Explorer Edition.

endmenu
```

## techpack/xiaomi-sdm845/power_supply/Kconfig
```kconfig
menu "Power supply"
	depends on POWER_SUPPLY

config IDT_P9220
	tristate "idtp9220 wireless Charger"
	depends on I2C
	help
	  Say Y to include support for idtp9220 wireless Charger.
	  idtp9220 is a wireless battery charger.
	  The driver supports charger enable/disable.
	  The driver reports the charger status via the power supply framework.
	  The driver controls idtp9220 via I2C and
	  supports device-tree interface.

endmenu
```

## techpack/xiaomi-sdm845/regulator/Kconfig
```kconfig
menu "Regulator"
	depends on REGULATOR

config REGULATOR_RTMV20
	tristate "Richtek RTMV20 Laser Diode Regulator"
	depends on I2C
	select REGMAP_I2C
	help
	  This driver adds support for the load switch current regulator on
	  the Richtek RTMV20. It can support the load current up to 6A and
	  integrate strobe/vsync/fsin signal to synchronize the IR camera.

endmenu
```

## techpack/xiaomi-sdm845/touchscreen/Kconfig
```kconfig
menu "Touchscreen"
	depends on INPUT_TOUCHSCREEN

source "techpack/xiaomi-sdm845/touchscreen/focaltech_touch_mi/Kconfig"
source "techpack/xiaomi-sdm845/touchscreen/ft5x46/Kconfig"
source "techpack/xiaomi-sdm845/touchscreen/fts_521/Kconfig"
source "techpack/xiaomi-sdm845/touchscreen/ndt/Kconfig"
source "techpack/xiaomi-sdm845/touchscreen/nt36xxx/Kconfig"
source "techpack/xiaomi-sdm845/touchscreen/synaptics_dsx_force/Kconfig"
source "techpack/xiaomi-sdm845/touchscreen/xiaomi/Kconfig"

config TOUCHSCREEN_ATMEL_MXT_MI
	tristate "Atmel mXT I2C Touchscreen"
	depends on I2C
	select FW_LOADER
	help
	  Say Y here if you have Atmel mXT series I2C touchscreen,
	  such as AT42QT602240/ATMXT224, connected to your system.

	  If unsure, say N.

	  To compile this driver as a module, choose M here: the
	  module will be called atmel_mxt_ts.

endmenu
```

## techpack/xiaomi-sdm845/touchscreen/ndt/Kconfig
```kconfig
config INPUT_PRESS_NDT
	bool "ndt"
	depends on I2C
	help
	  Say Y here if you have a press ic ndt.

config INPUT_PRESS_NDT_F60
	bool "ndt f60"
	depends on INPUT_PRESS_NDT
	help
	  Say Y here if you have a press ic ndt.

config INPUT_PRESS_NDT_M65
	bool "ndt m65"
	depends on INPUT_PRESS_NDT
	help
	  Say Y here if you have a press ic ndt.
```
